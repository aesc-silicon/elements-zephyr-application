## sample.yaml
```
# This file is provided so that the application can be compiled using Twister,
# the Zephyr testing tool. In this file, multiple combinations can be specified,
# so that you can easily test all of them locally or in CI.
sample:
  description: Test application
  name: test-application
common:
  build_only: true
  integration_platforms:
    - ecpix5/helium1
tests:
  app.default: {}
  app.debug:
    extra_overlay_confs:
      - debug.conf
```

## prj.conf
```kconfig
# Copyright (c) 2021 Nordic Semiconductor ASA
# SPDX-License-Identifier: Apache-2.0
#
# This file contains selected Kconfig options for the application.

CONFIG_SHELL=y
CONFIG_CONSOLE=y
CONFIG_UART_CONSOLE=y
CONFIG_BOOT_BANNER=y
```

## src/main.c
```c
/*
 * Copyright (c) 2024 aesc silicon
 * SPDX-License-Identifier: Apache-2.0
 */

#include <zephyr/kernel.h>

/* size of stack area used by each thread */
#define NOTHING_STACKSIZE 2048

/* scheduling priority used by each thread */
#define NOTHING_PRIORITY 5

void nothing(void)
{
	while (1) {
		k_sleep(K_SECONDS(1));
	}
}

K_THREAD_DEFINE(nothing_tid, NOTHING_STACKSIZE, nothing, NULL, NULL, NULL,
		NOTHING_PRIORITY, 0, 0);
```
