## CMakeLists.txt
```
#-------------------------------------------------------------------------------
# Zephyr Example Application
#
# Copyright (c) 2021 Nordic Semiconductor ASA
# SPDX-License-Identifier: Apache-2.0

cmake_minimum_required(VERSION 3.13.1)
find_package(Zephyr REQUIRED HINTS $ENV{ZEPHYR_BASE})

project(app LANGUAGES C)

target_sources(app PRIVATE
  src/main.c
  ../common/gpio/heartbeat.c
  ../common/gpio/sw0.c
  ../common/pwm/fader.c
)
```

## sample.yaml
```
# This file is provided so that the application can be compiled using Twister,
# the Zephyr testing tool. In this file, multiple combinations can be specified,
# so that you can easily test all of them locally or in CI.
sample:
  description: Example application
  name: example-application
common:
  build_only: true
  integration_platforms:
    - ecpix5/helium2
tests:
  app.default: {}
  app.debug:
    extra_overlay_confs:
      - debug.conf
```

## prj.conf
```kconfig
# Copyright (c) 2021 Nordic Semiconductor ASA
# SPDX-License-Identifier: Apache-2.0
#
# This file contains selected Kconfig options for the application.

CONFIG_SHELL=y
CONFIG_LOG=y
```

## src/main.c
```c
/*
 * Copyright (c) 2024 aesc silicon
 * SPDX-License-Identifier: Apache-2.0
 */

#include <zephyr/kernel.h>

#include "../../common/pwm/fader.h"
#include "../../common/gpio/heartbeat.h"
#include "../../common/gpio/sw0.h"

#ifdef CONFIG_PWM
K_THREAD_DEFINE(fader_tid, FADER_STACKSIZE, fader, NULL, NULL, NULL,
		FADER_PRIORITY, 0, 0);
#endif

#ifdef CONFIG_GPIO
K_THREAD_DEFINE(heartbeat_tid, HEARTBEAT_STACKSIZE, heartbeat, NULL, NULL, NULL,
		HEARTBEAT_PRIORITY, 0, 0);

K_THREAD_DEFINE(software0_button_tid, SOFTWARE0_BUTTON_STACKSIZE,
		software0_button, NULL, NULL, NULL, SOFTWARE0_BUTTON_PRIORITY, 0, 0);
#endif
```
