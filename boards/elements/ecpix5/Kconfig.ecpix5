## boards/elements/ecpix5/Kconfig.ecpix5
```kconfig
# Copyright (c) 2024 aesc silicon
# SPDX-License-Identifier: Apache-2.0

config BOARD_ECPIX5
	select SOC_HELIUM1 if BOARD_ECPIX5_HELIUM1
	help
	  ECPIX5 Boards
```

## drivers/gpio/Kconfig.elements
```kconfig
# Copyright (c) 2024 aesc silicon
# SPDX-License-Identifier: Apache-2.0


menuconfig GPIO_ELEMENTS
	bool "Elements GPIO driver"
	default y
	depends on DT_HAS_ELEMENTS_GPIO_ENABLED
	help
	  Enable driver for the Elements GPIO controller.

	  Says n if not sure.

if GPIO_ELEMENTS

config GPIO_ELEMENTS_INTERRUPT
	bool "Enable interrupt support"
	default y

endif # GPIO_ELEMENTS
```

## drivers/pwm/Kconfig
```kconfig
# Copyright (c) 2024 Nordic Semiconductor ASA
# SPDX-License-Identifier: Apache-2.0


if GPIO

module = GPIO
module-str = gpio
source "subsys/logging/Kconfig.template.log_config"

rsource "Kconfig.elements"

endif # GPIO
```

## drivers/pwm/Kconfig.elements
```kconfig
# Copyright (c) 2024 aesc silicon
# SPDX-License-Identifier: Apache-2.0

config PWM_ELEMENTS
	bool "Elements PWM driver"
	default y
	depends on DT_HAS_ELEMENTS_PWM_ENABLED
	help
	  Enable driver for the Elements PWM controller.

	  Says n if not sure.
```

## drivers/serial/Kconfig
```kconfig
# Copyright (c) 2024 Nordic Semiconductor ASA
# SPDX-License-Identifier: Apache-2.0


if SERIAL

module = SERIAL
module-str = serial
source "subsys/logging/Kconfig.template.log_config"

rsource "Kconfig.elements"

endif # SERIAL
```

## drivers/serial/Kconfig.elements
```kconfig
# Copyright (c) 2024 aesc silicon
# SPDX-License-Identifier: Apache-2.0


menuconfig UART_ELEMENTS
	bool "Elements UART driver"
	default y
	depends on DT_HAS_ELEMENTS_UART_ENABLED
	select SERIAL_HAS_DRIVER
	help
	  Enable driver for the Elements UART controller.

	  Says n if not sure.
```

## dts/bindings/pwm/elements,pwm.yaml
```yaml
# Copyright (c) 2024, aesc silicon
# SPDX-License-Identifier: Apache-2.0


description: ELements PWM

include: [pwm-controller.yaml, base.yaml]

compatible: "elements,pwm"

properties:

  clock-frequency:
    type: int
    required: true
    description: Default PWM Peripheral Clock frequency in Hz

  reg:
    required: true

  "#pwm-cells":
    const: 3

pwm-cells:
  - channel
  - period
  - flags
```

## dts/bindings/serial/elements,uart.yaml
```yaml
#
# Copyright (c) 2024 aesc silicon
#
# SPDX-License-Identifier: Apache-2.0
#
---

description: Elements UART - This binding gives a base representation of the Elements UART

compatible: "elements,uart"

# inherits:
include: uart-controller.yaml

properties:
    reg:
      type: array
      description: mmio register space
      required: true

    interrupts:
      type: array
      required: true
      description: required interrupts
```

## lib/Kconfig
```kconfig
# Copyright (c) 2021 Legrand North America, LLC.
# SPDX-License-Identifier: Apache-2.0

menu "Custom libraries"

config NAFARR_IP_IDENTIFICATION
  bool "Nafarr IP Identification"
  help
    Enable Nafarr's IP Identification library to detect IPs
    and relocate driver addresses.

endmenu
```

## west.yml
```yaml
# Copyright (c) 2021 Nordic Semiconductor ASA
# SPDX-License-Identifier: Apache-2.0

manifest:
  self:
    west-commands: scripts/west-commands.yml

  defaults:
    remote: aesc-silicon
    revision: main

  remotes:
    - name: zephyrproject-rtos
      url-base: https://github.com/zephyrproject-rtos
    - name: aesc-silicon
      url-base: https://github.com/aesc-silicon
    - name: spinalhdl
      url-base: https://github.com/spinalhdl

  projects:
    - name: elements-zephyr
      revision: v3.7.0-aesc
      import:
        path-allowlist: modules/elements/*
    - name: elements-zibal
      path: modules/elements/zibal
    - name: elements-nafarr
      path: modules/elements/nafarr
    - name: elements-vexriscv
      path: modules/elements/vexriscv
    - name: SpinalCrypto
      revision: master
      path: modules/elements/SpinalCrypto
      remote: spinalhdl
```
